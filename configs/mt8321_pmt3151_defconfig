## configs/mt8321_pmt3151_defconfig
```kconfig
CONFIG_ARM=y
CONFIG_COUNTER_FREQUENCY=13000000
CONFIG_SYS_THUMB_BUILD=y
CONFIG_ARCH_MEDIATEK=y
CONFIG_TEXT_BASE=0x81e00000
CONFIG_SYS_MALLOC_F_LEN=0x8000
CONFIG_SPL_GPIO=y
CONFIG_NR_DRAM_BANKS=1
CONFIG_SPL_LDSCRIPT="arch/arm/cpu/u-boot-spl.lds"
CONFIG_DM_GPIO=y
CONFIG_DEFAULT_DEVICE_TREE="mt8321-prestigio-pmt3151"
CONFIG_DM_RESET=y
CONFIG_SPL_MMC=y
CONFIG_SPL_SERIAL=y
CONFIG_SPL_STACK_R_ADDR=0x80800000
CONFIG_SPL_TEXT_BASE=0x201000
CONFIG_SPL_BSS_MAX_SIZE=0x40000
CONFIG_SPL_STACK_R=y
CONFIG_SYS_LOAD_ADDR=0x86000000
CONFIG_SPL_SIZE_LIMIT=0x40000
CONFIG_SPL=y
CONFIG_DEBUG_UART_BASE=0x11005000
CONFIG_DEBUG_UART_CLOCK=26000000
CONFIG_SYS_CLK_FREQ=26000000
CONFIG_DEBUG_UART=y
# CONFIG_EFI_LOADER is not set
# CONFIG_ANDROID_BOOT_IMAGE is not set
# CONFIG_AUTOBOOT is not set
CONFIG_DEFAULT_FDT_FILE="mt8321-prestigio-pmt3151"
CONFIG_LOGLEVEL=9
# CONFIG_SYS_DEVICE_NULLDEV is not set
CONFIG_LOG_MAX_LEVEL=9
CONFIG_LOGF_FILE=y
CONFIG_LOGF_FUNC=y
CONFIG_SPL_LOG=y
CONFIG_SPL_LOG_MAX_LEVEL=9
# CONFIG_BOARD_INIT is not set
CONFIG_SPL_MAX_SIZE=0x40000
CONFIG_SPL_PAD_TO=0x0
CONFIG_SPL_SYS_MMCSD_RAW_MODE=y
CONFIG_SYS_MMCSD_RAW_MODE_U_BOOT_SECTOR=0x200
# CONFIG_SYS_MMCSD_FS_BOOT is not set
CONFIG_SPL_MMC_TINY=y
CONFIG_SPL_MMC_WRITE=y
CONFIG_SPL_POWER=y
CONFIG_SPL_WATCHDOG=y
CONFIG_CMD_UFETCH=y
# CONFIG_CMD_BIND is not set
CONFIG_CMD_DM=y
CONFIG_CMD_GPIO=y
CONFIG_CMD_I2C=y
CONFIG_CMD_MMC=y
CONFIG_CMD_PMIC=y
CONFIG_CMD_REGULATOR=y
CONFIG_CMD_LOG=y
CONFIG_EFI_PARTITION=y
CONFIG_PARTITION_TYPE_GUID=y
CONFIG_OF_SPL_REMOVE_PROPS=""
CONFIG_ENV_RELOC_GD_ENV_ADDR=y
CONFIG_NO_NET=y
CONFIG_SPL_DM_SEQ_ALIAS=y
CONFIG_SPL_SYSCON=y
CONFIG_SIMPLE_BUS_CORRECT_RANGE=y
# CONFIG_OF_TRANSLATE is not set
CONFIG_CLK=y
CONFIG_SPL_CLK=y
CONFIG_USB_FUNCTION_FASTBOOT=y
CONFIG_FASTBOOT_BUF_ADDR=0x83000000
CONFIG_FASTBOOT_FLASH=y
CONFIG_FASTBOOT_UUU_SUPPORT=y
CONFIG_FASTBOOT_FLASH_MMC_DEV=0
CONFIG_FASTBOOT_MMC_BOOT_SUPPORT=y
CONFIG_FASTBOOT_MMC_USER_SUPPORT=y
CONFIG_FASTBOOT_OEM_RUN=y
CONFIG_FASTBOOT_OEM_BOARD=y
CONFIG_DM_I2C=y
CONFIG_IOMMU=y
CONFIG_MEDIATEK_IOMMU=y
CONFIG_MMC_IO_VOLTAGE=y
CONFIG_SPL_MMC_IO_VOLTAGE=y
CONFIG_MMC_UHS_SUPPORT=y
CONFIG_SPL_MMC_UHS_SUPPORT=y
CONFIG_MMC_HS400_SUPPORT=y
CONFIG_SPL_MMC_HS400_SUPPORT=y
CONFIG_MMC_MTK=y
CONFIG_PHY=y
CONFIG_PHY_MTK_TPHY=y
CONFIG_PINCTRL=y
CONFIG_PINCONF=y
CONFIG_SPL_PINCTRL=y
CONFIG_SPL_PINCONF=y
CONFIG_PINCTRL_MT6580=y
CONFIG_DM_PMIC=y
CONFIG_MTK_PWRAP=y
CONFIG_MTK_PMIC=y
CONFIG_DM_REGULATOR=y
CONFIG_SPL_DM_REGULATOR=y
CONFIG_REGULATOR_MTK=y
CONFIG_POWER_MT6323=y
CONFIG_RAM=y
CONFIG_SPL_RAM=y
CONFIG_DM_SERIAL=y
CONFIG_DEBUG_UART_SHIFT=2
CONFIG_DEBUG_UART_ANNOUNCE=y
CONFIG_MTK_SERIAL=y
CONFIG_SYSRESET=y
CONFIG_SYSRESET_WATCHDOG=y
CONFIG_TIMER=y
CONFIG_SPL_TIMER=y
CONFIG_MTK_TIMER=y
CONFIG_USB=y
CONFIG_USB_MUSB_GADGET=y
CONFIG_USB_MUSB_MT6580=y
CONFIG_USB_GADGET=y
CONFIG_USB_FUNCTION_ACM=y
CONFIG_VIDEO=y
CONFIG_VIDEO_ANSI=y
CONFIG_SYS_WHITE_ON_BLACK=y
CONFIG_PANEL_K710_HZ_JD9366_BOE_WXGA_IPS_101=y
CONFIG_VIDEO_BRIDGE=y
CONFIG_VIDEO_MTK=y
CONFIG_VIDEO_MTK_DSI=y
CONFIG_VIDEO_MTK_MUTEX=y
CONFIG_VIDEO_MTK_MMSYS=y
CONFIG_VIDEO_MTK_OVL=y
CONFIG_VIDEO_MTK_RDMA=y
CONFIG_VIDEO_MTK_DISPLAY_PWM=y
CONFIG_BMP=y
CONFIG_VIDEO_BMP_GZIP=y
CONFIG_BMP_16BPP=y
CONFIG_BMP_24BPP=y
CONFIG_BMP_32BPP=y
CONFIG_WDT_MTK=y
# CONFIG_SPL_USE_TINY_PRINTF is not set
CONFIG_SHA256=y
# CONFIG_SPL_SHA256 is not set
```

## drivers/video/mediatek/Kconfig
```kconfig
# SPDX-License-Identifier: GPL-2.0+
#
# Copyright (C) 2026 Pavel Ivanov <predefine@yandex.ru>

menuconfig VIDEO_MTK
	bool "Enable Mediatek Video Support"
	depends on VIDEO && VIDEO_BRIDGE && PANEL

if VIDEO_MTK

config VIDEO_MTK_DSI
	bool "Mediatek DSI"
	depends on VIDEO_MTK && VIDEO_MIPI_DSI
  select PHY_MTK_DPHY

config VIDEO_MTK_MUTEX
	bool "Mediatek MUTEX"
	depends on VIDEO_MTK

config VIDEO_MTK_MMSYS
	bool "Mediatek MMSYS"
	depends on VIDEO_MTK

config VIDEO_MTK_OVL
	bool "Mediatek OVL"
	depends on VIDEO_MTK

config VIDEO_MTK_RDMA
	bool "Mediatek RDMA"
	depends on VIDEO_MTK

config VIDEO_MTK_DISPLAY_PWM
	bool "Mediatek Display PWM"
	depends on VIDEO_MTK

endif
```
