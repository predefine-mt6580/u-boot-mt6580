/dts-v1/;
#include "mt6572.dtsi"
//#include "mt6323.dtsi"
#include "skeleton.dtsi"

/ {
  model = "JTY D101";
	compatible = "jty,d101";

	chosen {
		tick-timer = &gpt;
	};

	memory {
		#address-cells = <1>;
		#size-cells = <1>;
		device_type = "memory";
		reg = <0x80000000 0x40000000>;
	};
};

&uart0 {
	status = "okay";
};
